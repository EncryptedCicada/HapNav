## ZephyrProject/Firmware/lib/haptics/Kconfig
```kconfig
# SPDX-License-Identifier: Apache-2.0
#
# HapNav wristband haptic policy + selftest harness.

menu "HapNav haptics"

config HAPNAV_HAPTICS
	bool "Enable wristband haptic stack"
	default y
	depends on HAPTIC_DA7280
	help
	  Enables the high-level haptic policy that maps the BLE obstacles
	  report onto the four DA7280-driven LRAs.

if HAPNAV_HAPTICS

config HAPNAV_SELFTEST
	bool "Run isolated DA7280 selftest sequence"
	default n
	help
	  When enabled, the wristband does NOT react to incoming BLE frames.
	  Instead it spawns a dedicated thread at boot that executes a
	  comprehensive bench-test sequence on the four DA7280 channels:
	  probe + telemetry, channel walk, ramps, crossfades, all-on
	  stress, update-rate stress, drop-off pattern, simulated obstacle
	  reactions, fatigue taper, watchdog mute, and idle-hold IRQ
	  surveillance. BLE remains up so JSON frames still print on UART.

config HAPNAV_SELFTEST_THREAD_STACK_SIZE
	int "Selftest thread stack size"
	default 2048
	depends on HAPNAV_SELFTEST
	help
	  Stack size for the selftest runner thread. Tests issue a lot of
	  printk()/LOG_INF() calls so stay generous.

endif # HAPNAV_HAPTICS

endmenu
```

## ZephyrProject/Firmware/modules/da7280-haptic/drivers/haptic/Kconfig
```kconfig
# Copyright (c) 2026 (Your Company)
# SPDX-License-Identifier: Apache-2.0

menuconfig HAPTIC_DA7280
	bool "Renesas DA7280 haptic driver"
	default y
	depends on DT_HAS_DLG_DA7280_ENABLED
	select I2C
	select GPIO if $(dt_compat_any_has_prop,$(DT_COMPAT_DLG_DA7280),irq-gpios)
	help
	  Enable the driver for the Renesas (formerly Dialog) DA7280 haptic
	  motor driver. Targets DRO mode for direct I2C amplitude control of
	  an LRA or ERM.

if HAPTIC_DA7280

config HAPTIC_DA7280_INIT_PRIORITY
	int "DA7280 init priority"
	default 80
	help
	  Init priority. Must be after I2C and GPIO controllers
	  (POST_KERNEL by default for those).

config HAPTIC_DA7280_TOTAL_DRIVE_CAP
	int "Total drive cap across all DA7280 instances"
	default 200
	range 0 1020
	help
	  Sum of |amplitude| across all DA7280 instances will be clamped to
	  this value. Protects shared supply rails when driving multiple
	  LRAs simultaneously. The maximum (4 * 255) is 1020 with
	  acceleration disabled, or (4 * 127) = 508 with acceleration on.
	  Set to 0 to disable the budget check (per-channel cap still
	  applies).

config HAPTIC_DA7280_SAFE_INIT
	bool "Force INACTIVE / TOP_CTL2=0 at probe (brownout-safe init)"
	default n
	help
	  When enabled, the driver writes TOP_CTL2 = 0 and forces OP_MODE
	  to INACTIVE as the very first I2C transactions in init, before
	  applying any configuration. This protects against the case where
	  the host MCU resets (e.g. brownout) while the DA7280 keeps power
	  and its registers persist with a non-zero amplitude.

	  Linux does NOT do this -- the upstream driver relies on the
	  chip's POR state, since on phone-class systems the SoC and the
	  haptic chip power-cycle together. Embedded platforms where the
	  DA7280 can survive a host reset should turn this on.

config HAPTIC_DA7280_ALLOW_PWM_MODE
	bool "Allow OPERATION_MODE = PWM"
	default n
	help
	  Permit da7280_set_mode(DA7280_OP_PWM). PWM mode requires an
	  external PWM signal on the DA7280's GPI_0/PWM pin in the range
	  10-250 kHz; this driver does NOT generate that signal. Enable
	  only if your application drives the pin from a separate PWM
	  peripheral and you understand the duty-cycle interpretation
	  changes between acceleration_en=0 and =1 (datasheet 5.2.5).

config HAPTIC_DA7280_WORKQUEUE_STACK_SIZE
	int "IRQ work handler stack size"
	default 1024
	help
	  Stack size for the dedicated workqueue used to run the IRQ
	  handler (which reads IRQ event registers over I2C and invokes
	  the user callback).

config HAPTIC_DA7280_USE_SYSTEM_WORKQUEUE
	bool "Use the system workqueue for IRQ handling"
	default n
	help
	  Use the Zephyr system workqueue instead of a dedicated one. Only
	  enable if your application is sure no item on the system queue
	  can stall the haptic fault handler.

module = HAPTIC_DA7280
module-str = DA7280
source "subsys/logging/Kconfig.template.log_config"

endif # HAPTIC_DA7280
```

## ZephyrProject/Firmware/modules/da7280-haptic/dts/bindings/i2c/dlg,da7280.yaml
```yaml
# SPDX-License-Identifier: Apache-2.0
#
# Renesas/Dialog DA7280 haptic driver (LRA / ERM).
#
# This binding exposes the DRO-mode subset relevant for direct-I2C amplitude
# control of an LRA. PWM/RTWM/ETWM modes are not handled by the Zephyr driver.

description: |
  Dialog/Renesas DA7280 haptic motor driver. Drives a single LRA or ERM
  via I2C in Direct Register Override (DRO) mode.

  Property names follow the upstream Linux binding
  (Documentation/devicetree/bindings/input/dlg,da7280.txt) so that DT
  fragments can be ported between Linux and Zephyr with minimal changes.

  Acceleration mode changes the meaning of the amplitude register
  (TOP_CTL2): when on, it is a 7-bit signed value with magnitude up to 127;
  when off, an 8-bit unsigned value up to 255. The driver clamps writes
  according to the configured mode.

compatible: "dlg,da7280"

include: i2c-device.yaml

properties:
  irq-gpios:
    type: phandle-array
    description: |
      Optional GPIO pin connected to the DA7280 IRQ output. When present,
      the driver enables interrupt-driven fault handling (OC, UVLO, actuator
      fault, overtemp, sequence fault). On a serious fault the driver forces
      the channel back to INACTIVE and invokes the user callback.
      The DA7280 IRQ pin is open-drain active-low; configure it accordingly
      in the consumer node (typically GPIO_ACTIVE_LOW | GPIO_PULL_UP).
      In the upstream Linux binding this is expressed via 'interrupts-extended'
      instead -- Zephyr uses 'irq-gpios' by convention.

  dlg,actuator-type:
    type: string
    default: "LRA"
    enum:
      - "LRA"
      - "ERM-bar"
      - "ERM-coin"
    description: Motor type. Determines TOP_CFG1.ACTUATOR_TYPE and ERM-only quirks.

  dlg,nom-microvolt:
    type: int
    default: 2106000
    description: |
      Nominal RMS drive voltage in microvolts. Encoded into ACTUATOR1 at
      23.4 mV/LSB using Linux's rounding-up rule
      (code = uV / 23400 + 1, capped at 0xFF). Default 2.106 V is the
      SparkFun defaultMotor() target for the Jinlong G1040003D LRA;
      with Linux encoding this writes 0x5B (2.129 V actual).

  dlg,abs-max-microvolt:
    type: int
    default: 2260000
    description: |
      Absolute maximum drive voltage in microvolts. Encoded as
      code = uV / 23400 + 1.

  dlg,imax-microamp:
    type: int
    default: 165400
    description: |
      Maximum drive current in microamps. Encoded into ACTUATOR3.IMAX as
      a 5-bit code: code = (uA - 28600) / 7200 + 1, range 28.6 mA - 252.6 mA.

  dlg,impd-micro-ohms:
    type: int
    default: 13800000
    description: |
      Actuator coil impedance in micro-ohms. Used together with imax to
      compute the V2I calibration factor (CALIB_V2I_H/L). Default 13.8 ohm
      for the G1040003D LRA.

  dlg,resonant-freq-hz:
    type: int
    default: 170
    description: |
      LRA resonant frequency in hertz (integer; matches upstream Linux
      binding). Encoded as period count = 1e9 / (freq_hz * 1333) against
      the chip's nominal 750 kHz reference; high byte goes to FRQ_LRA_PER_H,
      low 7 bits to FRQ_LRA_PER_L.

  dlg,acc-enable:
    type: boolean
    description: |
      Enable active acceleration (TOP_CFG1.ACCELERATION_EN). Changes the
      interpretation of TOP_CTL2 to 7-bit signed (max magnitude 127) and
      enables V2I_FACTOR_OFFSET correction in TOP_CFG5.

  dlg,rapid-stop-enable:
    type: boolean
    description: Enable rapid-stop braking (TOP_CFG1.RAPID_STOP_EN).

  dlg,freq-track-enable:
    type: boolean
    description: |
      Enable closed-loop frequency tracking (TOP_CFG1.FREQ_TRACK_EN).
      Leave absent if the actuator's mechanical mounting could prevent
      the tracker from reaching resonance (causes E_ACTUATOR_FAULT).

  dlg,bemf-sens-enable:
    type: boolean
    description: Enable BEMF sensing (TOP_CFG1.BEMF_SENSE_EN).

  dlg,amp-pid-enable:
    type: boolean
    description: Enable amplitude PID closed loop (TOP_CFG1.AMP_PID_EN).

  per-channel-drive-cap:
    type: int
    default: 127
    description: |
      Zephyr-driver-specific per-instance amplitude clamp applied in
      da7280_set_amplitude(). Range 0-127 (acceleration mode) or 0-255
      (no acceleration). Driver clamps |amplitude| to this value before
      any global budget check. Default 127 = no clamp in accel mode.

  full-brake-thr:
    type: int
    default: 0
    description: |
      Full-brake threshold (TOP_CFG2[3:0], 0-15). 0 disables full-brake.

  bemf-fault-limit:
    type: int
    default: 1
    description: |
      BEMF fault limit (TOP_INT_CFG1[1:0]). 0 = disabled, 1 = 4.9 mV,
      2 = 27.9 mV, 3 = 49.9 mV. Default 1 matches chip POR. Forced to 0
      when actuator-type is "ERM-coin".

  vdd-margin:
    type: int
    default: 3
    description: |
      VDD margin (TOP_CFG3[3:0]) for automatic output limiting; 187.5 mV
      per LSB. Caps the drive voltage to (VDD - margin), preventing the
      regulator from clipping when the supply sags. Default 3 = 562.5 mV
      (matches chip POR).

  dlg,embedded-mode:
    type: boolean
    description: |
      Set TOP_CFG1.EMBEDDED_MODE: chip auto-clears its own faults and will
      attempt to drive again on the next request without host intervention.
      Useful for headless / no-host setups.

  dlg,standby-after-drive:
    type: boolean
    description: |
      Sets TOP_CTL1.STANDBY_EN to keep the chip in low-latency STANDBY
      between drives instead of dropping to IDLE (lower power but ~5x
      higher start-up latency). Linux always sets this during init and
      clears it on close; we expose it as a static DT choice.

  dlg,ps-seq-id:
    type: int
    default: 0
    description: |
      Pre-stored sequence ID (SEQ_CTL2[3:0], 0-15) selected for I2C
      sequence triggering in RTWM mode.

  dlg,ps-seq-loop:
    type: int
    default: 0
    description: |
      Pre-stored sequence loop count (SEQ_CTL2[7:4], 0-15). Number of
      additional repeats; 0 = play once, 15 = play 16 times.

  dlg,gpi0-seq-id:
    type: int
    default: 0
    description: GPI_0 sequence ID (GPI_0_CTL[6:3], 0-15).

  dlg,gpi0-mode:
    type: string
    default: "Single-pattern"
    enum: ["Single-pattern", "Multi-pattern"]
    description: GPI_0 single/multi-pattern selection.

  dlg,gpi0-polarity:
    type: string
    default: "Rising-edge"
    enum: ["Rising-edge", "Falling-edge", "Both-edge"]
    description: GPI_0 edge selection.

  dlg,gpi1-seq-id:
    type: int
    default: 1
    description: GPI_1 sequence ID (GPI_1_CTL[6:3], 0-15).

  dlg,gpi1-mode:
    type: string
    default: "Single-pattern"
    enum: ["Single-pattern", "Multi-pattern"]
    description: GPI_1 single/multi-pattern selection.

  dlg,gpi1-polarity:
    type: string
    default: "Rising-edge"
    enum: ["Rising-edge", "Falling-edge", "Both-edge"]
    description: GPI_1 edge selection.

  dlg,gpi2-seq-id:
    type: int
    default: 2
    description: GPI_2 sequence ID (GPI_2_CTL[6:3], 0-15).

  dlg,gpi2-mode:
    type: string
    default: "Single-pattern"
    enum: ["Single-pattern", "Multi-pattern"]
    description: GPI_2 single/multi-pattern selection.

  dlg,gpi2-polarity:
    type: string
    default: "Rising-edge"
    enum: ["Rising-edge", "Falling-edge", "Both-edge"]
    description: GPI_2 edge selection.

  dlg,mem-array:
    type: uint8-array
    description: |
      Optional 100-byte waveform memory image, formatted per datasheet
      section 5.8 (header with snippet/sequence counts and end-pointers
      followed by snippet PWL data and sequence frames). When present,
      the driver uploads this image to the chip after configuration.
      Sized matches upstream Linux dlg,mem-array but expressed as bytes
      directly here rather than as 32-bit cells.
```

## ZephyrProject/Firmware/west.yml
```yaml
manifest:
  version: "0.13"

  # With NixOS, ZEPHYR_BASE is set by the nix shell so west init is optional.
  # This manifest is here for explicit version pinning if ever needed.
  # To use it: west init -l . && west update
  #
  # For day-to-day development just enter the nix shell and run west build
  # directly from the pin/ or wristband/ directories.

  self:
    path: Firmware

  projects:
    - name: zephyr
      url: https://github.com/zephyrproject-rtos/zephyr
      revision: v3.7.0
      import: true

  defaults:
    remote: zephyrproject
  remotes:
    - name: zephyrproject
      url-base: https://github.com/zephyrproject-rtos
```
